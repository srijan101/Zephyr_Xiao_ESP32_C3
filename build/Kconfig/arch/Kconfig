## build/Kconfig/arch/Kconfig
```kconfig
# Load Zephyr Arch Kconfig descriptions.
osource "/Volumes/Project/Zephyr_Project/zephyr/arch/x86/Kconfig"
osource "/Volumes/Project/Zephyr_Project/zephyr/arch/xtensa/Kconfig"
osource "/Volumes/Project/Zephyr_Project/zephyr/arch/sparc/Kconfig"
osource "/Volumes/Project/Zephyr_Project/zephyr/arch/riscv/Kconfig"
osource "/Volumes/Project/Zephyr_Project/zephyr/arch/posix/Kconfig"
osource "/Volumes/Project/Zephyr_Project/zephyr/arch/nios2/Kconfig"
osource "/Volumes/Project/Zephyr_Project/zephyr/arch/mips/Kconfig"
osource "/Volumes/Project/Zephyr_Project/zephyr/arch/arm64/Kconfig"
osource "/Volumes/Project/Zephyr_Project/zephyr/arch/arm/Kconfig"
osource "/Volumes/Project/Zephyr_Project/zephyr/arch/arc/Kconfig"
```

## build/Kconfig/boards/Kconfig
```kconfig
# Load Zephyr board Kconfig descriptions.
osource "/Volumes/Project/Zephyr_Project/zephyr/boards/seeed/xiao_esp32c3/Kconfig"
```

## build/Kconfig/boards/Kconfig.defconfig
```kconfig
# Load Zephyr board defconfig descriptions.
osource "/Volumes/Project/Zephyr_Project/zephyr/boards/seeed/xiao_esp32c3/Kconfig.defconfig"
```

## build/Kconfig/boards/Kconfig.sysbuild
```kconfig
# Load Sysbuild board Kconfig descriptions.
osource "/Volumes/Project/Zephyr_Project/zephyr/boards/seeed/xiao_esp32c3/Kconfig.sysbuild"
```

## build/Kconfig/boards/Kconfig.xiao_esp32c3
```kconfig
# Load board Kconfig descriptions.
osource "/Volumes/Project/Zephyr_Project/zephyr/boards/seeed/xiao_esp32c3/Kconfig.xiao_esp32c3"
```

## build/Kconfig/soc/Kconfig
```kconfig
# Load Zephyr SoC Kconfig descriptions.
osource "/Volumes/Project/Zephyr_Project/zephyr/soc/xlnx/zynqmp/Kconfig"
osource "/Volumes/Project/Zephyr_Project/zephyr/soc/xlnx/zynq7000/Kconfig"
osource "/Volumes/Project/Zephyr_Project/zephyr/soc/xen/Kconfig"
osource "/Volumes/Project/Zephyr_Project/zephyr/soc/wch/ch32v00x/Kconfig"
osource "/Volumes/Project/Zephyr_Project/zephyr/soc/ti/simplelink/Kconfig"
osource "/Volumes/Project/Zephyr_Project/zephyr/soc/ti/lm3s6965/Kconfig"
osource "/Volumes/Project/Zephyr_Project/zephyr/soc/ti/k3/Kconfig"
osource "/Volumes/Project/Zephyr_Project/zephyr/soc/telink/tlsr/Kconfig"
osource "/Volumes/Project/Zephyr_Project/zephyr/soc/starfive/jh71xx/Kconfig"
osource "/Volumes/Project/Zephyr_Project/zephyr/soc/st/stm32/Kconfig"
osource "/Volumes/Project/Zephyr_Project/zephyr/soc/snps/qemu_arc/Kconfig"
osource "/Volumes/Project/Zephyr_Project/zephyr/soc/snps/nsim/arc_v/Kconfig"
osource "/Volumes/Project/Zephyr_Project/zephyr/soc/snps/nsim/arc_classic/Kconfig"
osource "/Volumes/Project/Zephyr_Project/zephyr/soc/snps/hsdk4xd/Kconfig"
osource "/Volumes/Project/Zephyr_Project/zephyr/soc/snps/hsdk/Kconfig"
osource "/Volumes/Project/Zephyr_Project/zephyr/soc/snps/emsk/Kconfig"
osource "/Volumes/Project/Zephyr_Project/zephyr/soc/snps/emsdp/Kconfig"
osource "/Volumes/Project/Zephyr_Project/zephyr/soc/snps/arc_iot/Kconfig"
osource "/Volumes/Project/Zephyr_Project/zephyr/soc/silabs/Kconfig"
osource "/Volumes/Project/Zephyr_Project/zephyr/soc/sifive/sifive_freedom/Kconfig"
osource "/Volumes/Project/Zephyr_Project/zephyr/soc/sensry/Kconfig"
osource "/Volumes/Project/Zephyr_Project/zephyr/soc/rockchip/Kconfig"
osource "/Volumes/Project/Zephyr_Project/zephyr/soc/renode/riscv_virtual/Kconfig"
osource "/Volumes/Project/Zephyr_Project/zephyr/soc/renode/cortex_r8_virtual/Kconfig"
osource "/Volumes/Project/Zephyr_Project/zephyr/soc/renesas/smartbond/Kconfig"
osource "/Volumes/Project/Zephyr_Project/zephyr/soc/renesas/rzt2m/Kconfig"
osource "/Volumes/Project/Zephyr_Project/zephyr/soc/renesas/rz/Kconfig"
osource "/Volumes/Project/Zephyr_Project/zephyr/soc/renesas/rcar/Kconfig"
osource "/Volumes/Project/Zephyr_Project/zephyr/soc/renesas/ra/Kconfig"
osource "/Volumes/Project/Zephyr_Project/zephyr/soc/raspberrypi/rpi_pico/Kconfig"
osource "/Volumes/Project/Zephyr_Project/zephyr/soc/quicklogic/eos_s3/Kconfig"
osource "/Volumes/Project/Zephyr_Project/zephyr/soc/qemu/virt_riscv/Kconfig"
osource "/Volumes/Project/Zephyr_Project/zephyr/soc/qemu/malta/Kconfig"
osource "/Volumes/Project/Zephyr_Project/zephyr/soc/openisa/rv32m1/Kconfig"
osource "/Volumes/Project/Zephyr_Project/zephyr/soc/nxp/s32/Kconfig"
osource "/Volumes/Project/Zephyr_Project/zephyr/soc/nxp/rw/Kconfig"
osource "/Volumes/Project/Zephyr_Project/zephyr/soc/nxp/mcx/Kconfig"
osource "/Volumes/Project/Zephyr_Project/zephyr/soc/nxp/lpc/Kconfig"
osource "/Volumes/Project/Zephyr_Project/zephyr/soc/nxp/layerscape/Kconfig"
osource "/Volumes/Project/Zephyr_Project/zephyr/soc/nxp/kinetis/Kconfig"
osource "/Volumes/Project/Zephyr_Project/zephyr/soc/nxp/imxrt/Kconfig"
osource "/Volumes/Project/Zephyr_Project/zephyr/soc/nxp/imx/Kconfig"
osource "/Volumes/Project/Zephyr_Project/zephyr/soc/nuvoton/numicro/Kconfig"
osource "/Volumes/Project/Zephyr_Project/zephyr/soc/nuvoton/numaker/Kconfig"
osource "/Volumes/Project/Zephyr_Project/zephyr/soc/nuvoton/npcx/Kconfig"
osource "/Volumes/Project/Zephyr_Project/zephyr/soc/nuvoton/npcm/Kconfig"
osource "/Volumes/Project/Zephyr_Project/zephyr/soc/nordic/Kconfig"
osource "/Volumes/Project/Zephyr_Project/zephyr/soc/neorv32/Kconfig"
osource "/Volumes/Project/Zephyr_Project/zephyr/soc/native/inf_clock/Kconfig"
osource "/Volumes/Project/Zephyr_Project/zephyr/soc/microchip/miv/Kconfig"
osource "/Volumes/Project/Zephyr_Project/zephyr/soc/microchip/mec/Kconfig"
osource "/Volumes/Project/Zephyr_Project/zephyr/soc/mediatek/mt8xxx/Kconfig"
osource "/Volumes/Project/Zephyr_Project/zephyr/soc/lowrisc/opentitan/Kconfig"
osource "/Volumes/Project/Zephyr_Project/zephyr/soc/litex/litex_vexriscv/Kconfig"
osource "/Volumes/Project/Zephyr_Project/zephyr/soc/ite/ec/Kconfig"
osource "/Volumes/Project/Zephyr_Project/zephyr/soc/intel/raptor_lake/Kconfig"
osource "/Volumes/Project/Zephyr_Project/zephyr/soc/intel/lakemont/Kconfig"
osource "/Volumes/Project/Zephyr_Project/zephyr/soc/intel/intel_socfpga_std/Kconfig"
osource "/Volumes/Project/Zephyr_Project/zephyr/soc/intel/intel_socfpga/Kconfig"
osource "/Volumes/Project/Zephyr_Project/zephyr/soc/intel/intel_niosv/Kconfig"
osource "/Volumes/Project/Zephyr_Project/zephyr/soc/intel/intel_ish/Kconfig"
osource "/Volumes/Project/Zephyr_Project/zephyr/soc/intel/intel_adsp/Kconfig"
osource "/Volumes/Project/Zephyr_Project/zephyr/soc/intel/elkhart_lake/Kconfig"
osource "/Volumes/Project/Zephyr_Project/zephyr/soc/intel/atom/Kconfig"
osource "/Volumes/Project/Zephyr_Project/zephyr/soc/intel/apollo_lake/Kconfig"
osource "/Volumes/Project/Zephyr_Project/zephyr/soc/intel/alder_lake/Kconfig"
osource "/Volumes/Project/Zephyr_Project/zephyr/soc/infineon/cat3/Kconfig"
osource "/Volumes/Project/Zephyr_Project/zephyr/soc/infineon/cat1b/Kconfig"
osource "/Volumes/Project/Zephyr_Project/zephyr/soc/infineon/cat1a/Kconfig"
osource "/Volumes/Project/Zephyr_Project/zephyr/soc/gd/gd32/Kconfig"
osource "/Volumes/Project/Zephyr_Project/zephyr/soc/gaisler/leon3/Kconfig"
osource "/Volumes/Project/Zephyr_Project/zephyr/soc/gaisler/gr716a/Kconfig"
osource "/Volumes/Project/Zephyr_Project/zephyr/soc/espressif/Kconfig"
osource "/Volumes/Project/Zephyr_Project/zephyr/soc/ene/kb1200/Kconfig"
osource "/Volumes/Project/Zephyr_Project/zephyr/soc/efinix/sapphire/Kconfig"
osource "/Volumes/Project/Zephyr_Project/zephyr/soc/cdns/xtensa_sample_controller/Kconfig"
osource "/Volumes/Project/Zephyr_Project/zephyr/soc/cdns/sample_controller32/Kconfig"
osource "/Volumes/Project/Zephyr_Project/zephyr/soc/cdns/dc233c/Kconfig"
osource "/Volumes/Project/Zephyr_Project/zephyr/soc/brcm/bcmvk/Kconfig"
osource "/Volumes/Project/Zephyr_Project/zephyr/soc/brcm/bcm2712/Kconfig"
osource "/Volumes/Project/Zephyr_Project/zephyr/soc/brcm/bcm2711/Kconfig"
osource "/Volumes/Project/Zephyr_Project/zephyr/soc/atmel/sam0/Kconfig"
osource "/Volumes/Project/Zephyr_Project/zephyr/soc/atmel/sam/Kconfig"
osource "/Volumes/Project/Zephyr_Project/zephyr/soc/aspeed/Kconfig"
osource "/Volumes/Project/Zephyr_Project/zephyr/soc/arm/Kconfig"
osource "/Volumes/Project/Zephyr_Project/zephyr/soc/arm/beetle/Kconfig"
osource "/Volumes/Project/Zephyr_Project/zephyr/soc/andestech/Kconfig"
osource "/Volumes/Project/Zephyr_Project/zephyr/soc/amd/acp_6_0/Kconfig"
osource "/Volumes/Project/Zephyr_Project/zephyr/soc/ambiq/Kconfig"
osource "/Volumes/Project/Zephyr_Project/zephyr/soc/altr/zephyr_nios2f/Kconfig"
osource "/Volumes/Project/Zephyr_Project/zephyr/soc/altr/qemu_nios2/Kconfig"
osource "/Volumes/Project/Zephyr_Project/zephyr/soc/adi/max32/Kconfig"
```

## build/Kconfig/soc/Kconfig.soc
```kconfig
# Load SoC Kconfig descriptions.
osource "/Volumes/Project/Zephyr_Project/zephyr/soc/xlnx/zynqmp/Kconfig.soc"
osource "/Volumes/Project/Zephyr_Project/zephyr/soc/xlnx/zynq7000/Kconfig.soc"
osource "/Volumes/Project/Zephyr_Project/zephyr/soc/xen/Kconfig.soc"
osource "/Volumes/Project/Zephyr_Project/zephyr/soc/wch/ch32v00x/Kconfig.soc"
osource "/Volumes/Project/Zephyr_Project/zephyr/soc/ti/simplelink/Kconfig.soc"
osource "/Volumes/Project/Zephyr_Project/zephyr/soc/ti/lm3s6965/Kconfig.soc"
osource "/Volumes/Project/Zephyr_Project/zephyr/soc/ti/k3/Kconfig.soc"
osource "/Volumes/Project/Zephyr_Project/zephyr/soc/telink/tlsr/Kconfig.soc"
osource "/Volumes/Project/Zephyr_Project/zephyr/soc/starfive/jh71xx/Kconfig.soc"
osource "/Volumes/Project/Zephyr_Project/zephyr/soc/st/stm32/Kconfig.soc"
osource "/Volumes/Project/Zephyr_Project/zephyr/soc/snps/qemu_arc/Kconfig.soc"
osource "/Volumes/Project/Zephyr_Project/zephyr/soc/snps/nsim/arc_v/Kconfig.soc"
osource "/Volumes/Project/Zephyr_Project/zephyr/soc/snps/nsim/arc_classic/Kconfig.soc"
osource "/Volumes/Project/Zephyr_Project/zephyr/soc/snps/hsdk4xd/Kconfig.soc"
osource "/Volumes/Project/Zephyr_Project/zephyr/soc/snps/hsdk/Kconfig.soc"
osource "/Volumes/Project/Zephyr_Project/zephyr/soc/snps/emsk/Kconfig.soc"
osource "/Volumes/Project/Zephyr_Project/zephyr/soc/snps/emsdp/Kconfig.soc"
osource "/Volumes/Project/Zephyr_Project/zephyr/soc/snps/arc_iot/Kconfig.soc"
osource "/Volumes/Project/Zephyr_Project/zephyr/soc/silabs/Kconfig.soc"
osource "/Volumes/Project/Zephyr_Project/zephyr/soc/sifive/sifive_freedom/Kconfig.soc"
osource "/Volumes/Project/Zephyr_Project/zephyr/soc/sensry/Kconfig.soc"
osource "/Volumes/Project/Zephyr_Project/zephyr/soc/rockchip/Kconfig.soc"
osource "/Volumes/Project/Zephyr_Project/zephyr/soc/renode/riscv_virtual/Kconfig.soc"
osource "/Volumes/Project/Zephyr_Project/zephyr/soc/renode/cortex_r8_virtual/Kconfig.soc"
osource "/Volumes/Project/Zephyr_Project/zephyr/soc/renesas/smartbond/Kconfig.soc"
osource "/Volumes/Project/Zephyr_Project/zephyr/soc/renesas/rzt2m/Kconfig.soc"
osource "/Volumes/Project/Zephyr_Project/zephyr/soc/renesas/rz/Kconfig.soc"
osource "/Volumes/Project/Zephyr_Project/zephyr/soc/renesas/rcar/Kconfig.soc"
osource "/Volumes/Project/Zephyr_Project/zephyr/soc/renesas/ra/Kconfig.soc"
osource "/Volumes/Project/Zephyr_Project/zephyr/soc/raspberrypi/rpi_pico/Kconfig.soc"
osource "/Volumes/Project/Zephyr_Project/zephyr/soc/quicklogic/eos_s3/Kconfig.soc"
osource "/Volumes/Project/Zephyr_Project/zephyr/soc/qemu/virt_riscv/Kconfig.soc"
osource "/Volumes/Project/Zephyr_Project/zephyr/soc/qemu/malta/Kconfig.soc"
osource "/Volumes/Project/Zephyr_Project/zephyr/soc/openisa/rv32m1/Kconfig.soc"
osource "/Volumes/Project/Zephyr_Project/zephyr/soc/nxp/s32/Kconfig.soc"
osource "/Volumes/Project/Zephyr_Project/zephyr/soc/nxp/rw/Kconfig.soc"
osource "/Volumes/Project/Zephyr_Project/zephyr/soc/nxp/mcx/Kconfig.soc"
osource "/Volumes/Project/Zephyr_Project/zephyr/soc/nxp/lpc/Kconfig.soc"
osource "/Volumes/Project/Zephyr_Project/zephyr/soc/nxp/layerscape/Kconfig.soc"
osource "/Volumes/Project/Zephyr_Project/zephyr/soc/nxp/kinetis/Kconfig.soc"
osource "/Volumes/Project/Zephyr_Project/zephyr/soc/nxp/imxrt/Kconfig.soc"
osource "/Volumes/Project/Zephyr_Project/zephyr/soc/nxp/imx/Kconfig.soc"
osource "/Volumes/Project/Zephyr_Project/zephyr/soc/nuvoton/numicro/Kconfig.soc"
osource "/Volumes/Project/Zephyr_Project/zephyr/soc/nuvoton/numaker/Kconfig.soc"
osource "/Volumes/Project/Zephyr_Project/zephyr/soc/nuvoton/npcx/Kconfig.soc"
osource "/Volumes/Project/Zephyr_Project/zephyr/soc/nuvoton/npcm/Kconfig.soc"
osource "/Volumes/Project/Zephyr_Project/zephyr/soc/nordic/Kconfig.soc"
osource "/Volumes/Project/Zephyr_Project/zephyr/soc/neorv32/Kconfig.soc"
osource "/Volumes/Project/Zephyr_Project/zephyr/soc/native/inf_clock/Kconfig.soc"
osource "/Volumes/Project/Zephyr_Project/zephyr/soc/microchip/miv/Kconfig.soc"
osource "/Volumes/Project/Zephyr_Project/zephyr/soc/microchip/mec/Kconfig.soc"
osource "/Volumes/Project/Zephyr_Project/zephyr/soc/mediatek/mt8xxx/Kconfig.soc"
osource "/Volumes/Project/Zephyr_Project/zephyr/soc/lowrisc/opentitan/Kconfig.soc"
osource "/Volumes/Project/Zephyr_Project/zephyr/soc/litex/litex_vexriscv/Kconfig.soc"
osource "/Volumes/Project/Zephyr_Project/zephyr/soc/ite/ec/Kconfig.soc"
osource "/Volumes/Project/Zephyr_Project/zephyr/soc/intel/raptor_lake/Kconfig.soc"
osource "/Volumes/Project/Zephyr_Project/zephyr/soc/intel/lakemont/Kconfig.soc"
osource "/Volumes/Project/Zephyr_Project/zephyr/soc/intel/intel_socfpga_std/Kconfig.soc"
osource "/Volumes/Project/Zephyr_Project/zephyr/soc/intel/intel_socfpga/Kconfig.soc"
osource "/Volumes/Project/Zephyr_Project/zephyr/soc/intel/intel_niosv/Kconfig.soc"
osource "/Volumes/Project/Zephyr_Project/zephyr/soc/intel/intel_ish/Kconfig.soc"
osource "/Volumes/Project/Zephyr_Project/zephyr/soc/intel/intel_adsp/Kconfig.soc"
osource "/Volumes/Project/Zephyr_Project/zephyr/soc/intel/elkhart_lake/Kconfig.soc"
osource "/Volumes/Project/Zephyr_Project/zephyr/soc/intel/atom/Kconfig.soc"
osource "/Volumes/Project/Zephyr_Project/zephyr/soc/intel/apollo_lake/Kconfig.soc"
osource "/Volumes/Project/Zephyr_Project/zephyr/soc/intel/alder_lake/Kconfig.soc"
osource "/Volumes/Project/Zephyr_Project/zephyr/soc/infineon/cat3/Kconfig.soc"
osource "/Volumes/Project/Zephyr_Project/zephyr/soc/infineon/cat1b/Kconfig.soc"
osource "/Volumes/Project/Zephyr_Project/zephyr/soc/infineon/cat1a/Kconfig.soc"
osource "/Volumes/Project/Zephyr_Project/zephyr/soc/gd/gd32/Kconfig.soc"
osource "/Volumes/Project/Zephyr_Project/zephyr/soc/gaisler/leon3/Kconfig.soc"
osource "/Volumes/Project/Zephyr_Project/zephyr/soc/gaisler/gr716a/Kconfig.soc"
osource "/Volumes/Project/Zephyr_Project/zephyr/soc/espressif/Kconfig.soc"
osource "/Volumes/Project/Zephyr_Project/zephyr/soc/ene/kb1200/Kconfig.soc"
osource "/Volumes/Project/Zephyr_Project/zephyr/soc/efinix/sapphire/Kconfig.soc"
osource "/Volumes/Project/Zephyr_Project/zephyr/soc/cdns/xtensa_sample_controller/Kconfig.soc"
osource "/Volumes/Project/Zephyr_Project/zephyr/soc/cdns/sample_controller32/Kconfig.soc"
osource "/Volumes/Project/Zephyr_Project/zephyr/soc/cdns/dc233c/Kconfig.soc"
osource "/Volumes/Project/Zephyr_Project/zephyr/soc/brcm/bcmvk/Kconfig.soc"
osource "/Volumes/Project/Zephyr_Project/zephyr/soc/brcm/bcm2712/Kconfig.soc"
osource "/Volumes/Project/Zephyr_Project/zephyr/soc/brcm/bcm2711/Kconfig.soc"
osource "/Volumes/Project/Zephyr_Project/zephyr/soc/atmel/sam0/Kconfig.soc"
osource "/Volumes/Project/Zephyr_Project/zephyr/soc/atmel/sam/Kconfig.soc"
osource "/Volumes/Project/Zephyr_Project/zephyr/soc/aspeed/Kconfig.soc"
osource "/Volumes/Project/Zephyr_Project/zephyr/soc/arm/Kconfig.soc"
osource "/Volumes/Project/Zephyr_Project/zephyr/soc/arm/beetle/Kconfig.soc"
osource "/Volumes/Project/Zephyr_Project/zephyr/soc/andestech/Kconfig.soc"
osource "/Volumes/Project/Zephyr_Project/zephyr/soc/amd/acp_6_0/Kconfig.soc"
osource "/Volumes/Project/Zephyr_Project/zephyr/soc/ambiq/Kconfig.soc"
osource "/Volumes/Project/Zephyr_Project/zephyr/soc/altr/zephyr_nios2f/Kconfig.soc"
osource "/Volumes/Project/Zephyr_Project/zephyr/soc/altr/qemu_nios2/Kconfig.soc"
osource "/Volumes/Project/Zephyr_Project/zephyr/soc/adi/max32/Kconfig.soc"
```
